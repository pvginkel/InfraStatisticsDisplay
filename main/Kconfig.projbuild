## main/Kconfig.projbuild
```kconfig
menu "Device Configuration"

    orsource "$IDF_PATH/examples/common_components/env_caps/$IDF_TARGET/Kconfig.env_caps"

    config WIFI_SSID
        string "WiFi SSID"

    config MQTT_BROKER_URL
        string "MQTT broker URL"

    config MQTT_USER_ID
        string "MQTT user ID"

    config DEVICE_CONFIG_ENDPOINT
        string "Device config endpoint (%s becomes MAC address)"

    config DEVICE_NETWORK_CONNECT_ATTEMPTS
        int "Network connection attempts"
        default 1

    config DEVICE_RESTART_ON_FAILURE_INTERVAL
        int "Timeout after which the device restarts when on the error screen in seconds"
        default 300

endmenu

menu "OTA Configuration"

    config OTA_ENDPOINT
        string "OTA endpoint"

    config OTA_CHECK_INTERVAL
        int "OTA check Interval in seconds"
        default 300

    config OTA_RECV_TIMEOUT
        int "OTA receive timeout in ms"
        default 15000

endmenu

menu "Logging Configuration"

    config LOG_ENDPOINT
        string "Logging endpoint"

    config LOG_INTERVAL
        int "Interval to upload log messages in ms"
        default 5000

    config LOG_RECV_TIMEOUT
        int "Logging receive timeout in ms"
        default 15000

endmenu

menu "Display Configuration"
    config DISPLAY_DOUBLE_FB
        bool "Use double Frame Buffer"
        default "n"
        help
            Enable this option, driver will allocate two frame buffers.

    config DISPLAY_USE_BOUNCE_BUFFER
        depends on !DISPLAY_DOUBLE_FB
        bool "Use bounce buffer"
        help
            Enable bounce buffer mode can achieve higher PCLK frequency at the cost of higher CPU consumption.

    config DISPLAY_AVOID_TEAR_EFFECT_WITH_SEM
        depends on !DISPLAY_DOUBLE_FB
        bool "Avoid tearing effect"
        default "y"
        help
            Enable this option, the example will use a pair of semaphores to avoid the tearing effect.
            Note, if the Double Frame Buffer is used, then we can also avoid the tearing effect without the lock.

    config DISPLAY_PIN_MOSI
        int "MOSI GPIO number"
        default 15 if IDF_TARGET_ESP32
        default 35 if IDF_TARGET_ESP32S2
        default 11 if IDF_TARGET_ESP32S3
        default 5  if IDF_TARGET_ESP32H2
        default 4  # C3 and others

    config DISPLAY_PIN_MISO
        int "MISO GPIO number"
        default 2 if IDF_TARGET_ESP32
        default 37 if IDF_TARGET_ESP32S2
        default 13 if IDF_TARGET_ESP32S3
        default 0  if IDF_TARGET_ESP32H2
        default 6  # C3 and others

    config DISPLAY_PIN_CLK
        int "CLK GPIO number"
        default 14 if IDF_TARGET_ESP32
        default 36 if IDF_TARGET_ESP32S2
        default 12 if IDF_TARGET_ESP32S3
        default 4  if IDF_TARGET_ESP32H2
        default 5  # C3 and others

    config DISPLAY_PIN_CS
        int "CS GPIO number"
        default 13 if IDF_TARGET_ESP32
        default 34 if IDF_TARGET_ESP32S2
        default -1 if IDF_TARGET_ESP32S3
        default 1  # C3 and others

    config DISPLAY_AUTO_OFF_MS
        int "Turn off display after ms"
        default 0
        
endmenu
```

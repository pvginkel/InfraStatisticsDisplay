## sdkconfig.defaults
```kconfig
# Application configuration

CONFIG_INFRA_STATISTICS_ENDPOINT="http://infrastatistics.home/stats?jobs=8"
CONFIG_DISPLAY_AUTO_OFF_MS=20000
CONFIG_DISPLAY_DOUBLE_FB=y

CONFIG_NETWORK_ENABLE_SNTP=y

CONFIG_IDF_TARGET="esp32s3"

# LVGL

CONFIG_LV_ASSERT_HANDLER_INCLUDE="../../../../main/lvgl_assert.h"
CONFIG_LV_COLOR_DEPTH_1=y
CONFIG_LV_CONF_MINIMAL=y
CONFIG_LV_FONT_DEFAULT_MONTSERRAT_8=y
CONFIG_LV_FONT_UNSCII_8=n
CONFIG_LV_MEM_CUSTOM=y
CONFIG_LV_MEMCPY_MEMSET_STD=y
CONFIG_LV_THEME_DEFAULT_GROW=n
CONFIG_LV_THEME_DEFAULT_TRANSITION_TIME=0
CONFIG_LV_TXT_BREAK_CHARS=""
CONFIG_LV_TXT_ENC_UTF8=y
CONFIG_LV_USE_ANIMIMG=y
CONFIG_LV_USE_ARC=y
CONFIG_LV_USE_ASSERT_MALLOC=y
CONFIG_LV_USE_ASSERT_NULL=y
CONFIG_LV_USE_ASSERT_STYLE=y
CONFIG_LV_USE_BTN=y
CONFIG_LV_USE_BTNMATRIX=y
CONFIG_LV_USE_CALENDAR=y
CONFIG_LV_USE_CANVAS=y
CONFIG_LV_USE_CHART=y
CONFIG_LV_USE_CHECKBOX=y
CONFIG_LV_USE_COLORWHEEL=y
CONFIG_LV_USE_DROPDOWN=y
CONFIG_LV_USE_FLEX=y
CONFIG_LV_USE_GRID=y
CONFIG_LV_USE_IMG=y
CONFIG_LV_USE_IMGBTN=y
CONFIG_LV_USE_KEYBOARD=y
CONFIG_LV_USE_LED=y
CONFIG_LV_USE_LINE=y
CONFIG_LV_USE_LIST=y
CONFIG_LV_USE_LOG=y
CONFIG_LV_USE_MENU=y
CONFIG_LV_USE_METER=y
CONFIG_LV_USE_MSGBOX=y
CONFIG_LV_USE_ROLLER=y
CONFIG_LV_USE_SLIDER=y
CONFIG_LV_USE_SPAN=y
CONFIG_LV_USE_SPINBOX=y
CONFIG_LV_USE_SPINNER=y
CONFIG_LV_USE_SWITCH=y
CONFIG_LV_USE_TABLE=y
CONFIG_LV_USE_TABVIEW=y
CONFIG_LV_USE_TEXTAREA=y
CONFIG_LV_USE_THEME_BASIC=y
CONFIG_LV_USE_THEME_DEFAULT=y
CONFIG_LV_USE_TILEVIEW=y
CONFIG_LV_USE_WIN=y



# Setup flash

CONFIG_ESPTOOLPY_FLASHSIZE_8MB=y
CONFIG_PARTITION_TABLE_CUSTOM=y

# SPIRAM

CONFIG_SPIRAM=y
CONFIG_SPIRAM_FETCH_INSTRUCTIONS=y
CONFIG_SPIRAM_RODATA=y
CONFIG_SPIRAM_SPEED_80M=y
CONFIG_SPIRAM_USE_CAPS_ALLOC=y

# MQTT

CONFIG_MQTT_TOPIC_PREFIX="pieter"
CONFIG_MQTT_DEVICE_MANUFACTURER="Pieter"
CONFIG_MQTT_DEVICE_MODEL="Infra Statistics Display"
CONFIG_MQTT_DEVICE_MODEL_ID="Infra Statistics Display v1"
```
